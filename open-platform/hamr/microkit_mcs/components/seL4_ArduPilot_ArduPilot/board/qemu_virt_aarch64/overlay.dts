/*
 * Copyright 2024, UNSW
 *
 * SPDX-License-Identifier: BSD-2-Clause
 */

  /* This file will not be overwritten if HAMR codegen is rerun */

/ {
    /* Need to specify how much RAM the guest will have */
    memory@80000000 {
        device_type = "memory";
        reg = <0x00 0x80000000 0x00 0x3f000000>;
    };

    flash@0 {
        status = "disabled";
    };

    chosen {
        stdout-path = "/pl011@9000000";
        bootargs = "console=ttyAMA0,115200 root=/dev/ram0 maxcpus=1 nosmp earlycon=pl011,0x9000000 earlyprintk=serial debug loglevel=8";
        linux,stdout-path = "/pl011@9000000";
        linux,initrd-start = <0x00 0xa0000000>;
        linux,initrd-end = <0x00 0xa7800000>;
    };
};
